## meta-mchp-distro/conf/distro/mchp-distro.conf
```bitbake
DISTRO = "mchp-distro"
DISTRO_NAME = "Microchip Distro"
DISTRO_VERSION = "1.0"

DISTROOVERRIDES = "${DISTRO}"
TARGET_VENDOR = "-mchp"
SDK_VENDOR = "-mchpsdk"
SDK_VERSION = "${DISTRO_VERSION}"

MAINTAINER = "\
		Valentina Fernandez <valentina.fernandezalanis@microchip.com> \
		Nicolas Ferre <nicolas.ferre@microchip.com> \
		Dharma Balasubiramani <dharma.b@microchip.com> \
		"

MCHP_INIT_MANAGER ?= "systemd"
PACKAGE_CLASSES ?= "package_ipk"

MCHP_DEFAULT_DISTRO_FEATURES = ""
DISTRO_FEATURES ?= "${MCHP_DEFAULT_DISTRO_FEATURES}"

INIT_MANAGER ?= "${MCHP_INIT_MANAGER}"

DISTROOVERRIDES:append = "${@bb.utils.contains('DISTRO_FEATURES', 'mchp-dm-verity', ':mchp-dm-verity', '', d)}"
require ${@bb.utils.contains('DISTRO_FEATURES', 'mchp-dm-verity', 'include/mchp-dm-verity.inc', '', d)}
```

## meta-mchp-mpu/meta-mchp-mpu-bsp/conf/machine/include/at91sam9.inc
```bitbake
# Microchip AT91SAM9 defaults
require conf/machine/include/soc-family.inc
require conf/machine/include/arm/armv5/tune-arm926ejs.inc
require conf/machine/include/common-conf.inc

SOC_FAMILY = "at91sam9"

KBUILD_DEFCONFIG = "at91_dt_defconfig"

PREFERRED_PROVIDER_virtual/kernel:at91sam9 ?= "linux-mchp"
PREFERRED_PROVIDER_virtual/bootloader:at91sam9 ?= "u-boot-mchp"
PREFERRED_PROVIDER_u-boot:at91sam9 ?= "u-boot-mchp"
PREFERRED_VERSION_linux-mchp = "6.18%"

SERIAL_CONSOLES ?= "115200;ttyS0"
```

## meta-mchp-mpu/meta-mchp-mpu-bsp/conf/machine/sama7g54-curiosity-pro-sd.conf
```bitbake
#@TYPE: Machine
#@Name: Microchip SAMA7G54-CURIOSITY-PRO SD
#@DESCRIPTION: Machine configuration for Microchip SAMA7G54 curiosity pro sd board

require include/sama7g5.inc

MACHINE_FEATURES += " wifi"

KERNEL_DEVICETREE = "microchip/at91-sama7g54_curiosity_pro.dtb"
DT_MACHINE ?= "sama7g54_curiosity_pro"

IMAGE_FSTYPES += " tar.gz wic"

WKS_FILE = "sdimage-bootpart.wks"
IMAGE_BOOT_FILES = "BOOT.BIN u-boot.bin uboot.env sama7g54_curiosity_pro.itb"

PREFERRED_VERSION_u-boot-mchp = "v2026.07%"

UBOOT_MACHINE ?= "sama7g54_curiosity_pro_mmc_defconfig"
UBOOT_ENTRYPOINT = "0x62000000"
UBOOT_LOADADDRESS = "0x62000000"
UBOOT_ENV_SIZE = "0x4000"

MACHINE_ESSENTIAL_EXTRA_RDEPENDS += " dt-overlay-mchp"

# Add deploy functions to the wic image dependency
do_image_wic[depends] += " u-boot-mchp:do_deploy"
do_image_wic[depends] += " dt-overlay-mchp:do_deploy"

MACHINEOVERRIDES =. "mpuall:sama7g54_curiosity_pro:"
```

## meta-mchp-mpu/meta-mchp-mpu-bsp/conf/machine/sama7g54-curiosity-pro.conf
```bitbake
#@TYPE: Machine
#@Name: MICROCHIP SAMA7G54-CURIOSITY-PRO NAND
#@DESCRIPTION: Machine configuration for Microchip SAMA7G54 curiosity pro nand board

require include/sama7g5.inc

MACHINE_FEATURES += " wifi"

KERNEL_DEVICETREE = "microchip/at91-sama7g54_curiosity_pro.dtb"
DT_MACHINE ?= "sama7g54_curiosity_pro"

IMAGE_FSTYPES += " ubi tar.gz"

MACHINE_ESSENTIAL_EXTRA_RDEPENDS += " dt-overlay-mchp"

# Add deploy functions to the wic image dependency
do_image_wic[depends] += " u-boot-mchp:do_deploy"
do_image_wic[depends] += " dt-overlay-mchp:do_deploy"

# NAND
MKUBIFS_ARGS = " -e 0x3e000 -c 2082 -m 0x1000 -x lzo"
UBINIZE_ARGS = " -m 0x1000 -p 0x40000"

UBI_VOLNAME = "rootfs"

PREFERRED_VERSION_u-boot-mchp = "v2026.07%"

UBOOT_MACHINE ?= "sama7g54_curiosity_pro_nandflash_defconfig"
UBOOT_ENTRYPOINT = "0x62000000"
UBOOT_LOADADDRESS = "0x62000000"
UBOOT_ENV_SIZE = "0x20000"

MACHINEOVERRIDES =. "mpuall:sama7g54_curiosity_pro:"
```

## meta-mchp-pic64/conf/machine/include/pic64gx-auth.inc
```bitbake
# HSS payload signing (ECDSA secp384r1)
HSS_PAYLOAD_PRIVATE_KEYNAME ?= "${@bb.utils.contains('MCHP_DEV_SIGNING_KEYS', '1', 'dev_', '', d)}x509-ec-secp384r1-private"
HSS_PAYLOAD_PUBLIC_KEYNAME ?= "${@bb.utils.contains('MCHP_DEV_SIGNING_KEYS', '1', 'dev_', '', d)}x509-ec-secp384r1-public"
HSS_SIGN_KEYDIR ?= "${TOPDIR}/../keys"
```
